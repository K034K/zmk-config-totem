## config/west.yml
```yaml
manifest:
  remotes:
    - name: zmkfirmware
      url-base: https://github.com/zmkfirmware
  projects:
    - name: zmk
      remote: zmkfirmware
      revision: v0.3.0
      import: app/west.yml
    - name: zmk-feature-charge-indicator
      url: https://github.com/4mplelab/zmk-feature-charge-indicator
      revision: main    # check the repo for version tags matching your ZMK version
  self:
    path: config
```
